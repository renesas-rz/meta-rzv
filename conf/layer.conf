## conf/layer.conf
```bitbake
LAYERDEPENDS_rzv2l = "core"
LAYERDEPENDS_rzv2l = "core yocto yoctobsp openembedded-layer meta-python"

# We have a conf and classes directory, add to BBPATH
BBPATH .= ":${LAYERDIR}"

# We have recipes-* directories, add to BBFILES
BBFILES += "${LAYERDIR}/recipes-*/*/*.bb \
    ${LAYERDIR}/recipes-*/*.bb \
    ${LAYERDIR}/recipes-*/*.bbappend \
    ${LAYERDIR}/recipes-*/*/*.bbappend"

# We only include the recipes-qt if we are having the QT_LAYER in bbconfig layer.
QTDIR = "${LAYERDIR}/dynamic-layers/qt5-layer"
BBFILES += "${@'${QTDIR}/*/*.bb	${QTDIR}/*/*.bbappend' if ('${QT_LAYER}' == 'True') else ' '}"
BBMASK_append = " qtwebengine "


BBFILE_COLLECTIONS += "rzv2l"
BBFILE_PATTERN_rzv2l = "^${LAYERDIR}/"
BBFILE_PRIORITY_rzv2l = "15"
LAYERSERIES_COMPAT_rzv2l = "dunfell"

HOSTTOOLS += "xz"
```

## conf/machine/smarc-rzv2l.conf
```bitbake
#@TYPE: Machine
#@NAME: smarc-rzv2l machine
#@DESCRIPTION: RZ/V2L SMARC platform

SOC_FAMILY = "r9a07g054l"
require conf/machine/include/rzg2l-common.inc
require conf/machine/include/cip-core.inc

DEFAULTTUNE ?= "cortexa55"

TUNE_CONF ?= "conf/machine/include/tune-cortexa55.inc"
require ${TUNE_CONF}

PREFERRED_PROVIDER_virtual/kernel="linux-renesas"

UBOOT_CONFIG ??= "smarc-rzv2l"
UBOOT_CONFIG[smarc-rzv2l] = "smarc-rzv2l_defconfig"
```
